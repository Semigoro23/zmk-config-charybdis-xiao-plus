## Kconfig
```kconfig
config Y13_XIAO_LOW_CHARGE
    bool "Keep XIAO charge selector P0.13 high impedance (nominal 50 mA)"
    default y
    depends on BOARD_SEEEDUINO_XIAO_BLE
    help
      Configure P0.13 as input without pulls. No high-current charging mode.
      Battery protection and charging completion must be checked on hardware.
```

## config/west.yml
```yaml
manifest:
  remotes:
    - name: zmkfirmware
      url-base: https://github.com/zmkfirmware
    - name: DoctorWangWang
      url-base: https://github.com/DoctorWangWang
  projects:
    - name: zmk
      remote: zmkfirmware
      revision: edf5c0814fd3ea202e43aad2d68fd32e882a518c
      import: app/west.yml
    - name: zmk-pmw3610-driver
      remote: DoctorWangWang
      revision: 1d9c2c68ca76012e1b1e5f6ef02fa5eadc4ca399
  self:
    path: config
```
