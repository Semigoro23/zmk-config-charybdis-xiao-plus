/*
 * Copyright (c) 2020 ZMK Contributors
 *
 * SPDX-License-Identifier: MIT
 */

#include "charybdis.dtsi"

&kscan0 {
    /* Rev G: C1 D3, C2 D0, C3 D9, C4 D10, C5 D11, C6 D12 */
    col-gpios = <&gpio0 29 (GPIO_ACTIVE_HIGH | GPIO_PULL_DOWN)>,
                <&gpio0 2 (GPIO_ACTIVE_HIGH | GPIO_PULL_DOWN)>,
                <&gpio1 14 (GPIO_ACTIVE_HIGH | GPIO_PULL_DOWN)>,
                <&gpio1 15 (GPIO_ACTIVE_HIGH | GPIO_PULL_DOWN)>,
                <&gpio0 15 (GPIO_ACTIVE_HIGH | GPIO_PULL_DOWN)>,
                <&gpio0 19 (GPIO_ACTIVE_HIGH | GPIO_PULL_DOWN)>;
};
&left_encoder {
    status = "okay";
};
//RGB bus


